# file: ECSE444_Lab1.ioc
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Mcu.Family=STM32L4
Mcu.Name=STM32L4S5VITx
Mcu.Package=LQFP100
NVIC.PriorityGroup=NVIC_PRIORITYGROUP_4
PA13\ (JTMS/SWDIO).Signal=SYS_JTMS-SWDIO
PB3\ (JTDO/TRACESWO).Signal=SYS_JTDO-SWO
ProjectManager.HeapSize=0x200
ProjectManager.StackSize=0x400
ProjectManager.TargetToolchain=STM32CubeIDE
RCC.ADCFreq_Value=48000000
RCC.AHBFreq_Value=120000000
RCC.APB1Freq_Value=120000000
RCC.APB1TimFreq_Value=120000000
RCC.APB2Freq_Value=120000000
RCC.APB2TimFreq_Value=120000000
RCC.CortexFreq_Value=120000000
RCC.HCLKFreq_Value=120000000
RCC.HSE_VALUE=8000000
RCC.HSI48_VALUE=48000000
RCC.HSI_VALUE=16000000
RCC.LSE_VALUE=32768
RCC.MSI_VALUE=4000000
RCC.PLLN=60
RCC.PLLSAI1N=24
RCC.SYSCLKFreq_VALUE=120000000
RCC.SYSCLKSource=RCC_SYSCLKSOURCE_PLLCLK
RCC.USBFreq_Value=48000000
RCC.VCOOutputFreq_Value=240000000
TIM2.Period=3000
TIM2.Prescaler=40000
VP_TIM2_VS_ClockSourceINT.Mode=Internal
board=B-L4S5I-IOT01A

// file: Core/Src/main.c
/* USER CODE BEGIN Header */
/**
  ******************************************************************************
  * @file           : main.c
  * @brief          : Main program body
  ******************************************************************************
  * @attention
  *
  * <h2><center>&copy; Copyright (c) 2021 STMicroelectronics.
  * All rights reserved.</center></h2>
  *
  * This software component is licensed by ST under BSD 3-Clause license,
  * the "License"; You may not use this file except in compliance with the
  * License. You may obtain a copy of the License at:
  *                        opensource.org/licenses/BSD-3-Clause
  *
  ******************************************************************************
  */
/* USER CODE END Header */
#include "main.h"
#include "math.h"
#include "arm_math.h"
#include "kalman.h"

/* USER CODE BEGIN PD */
#define ITM_Port32(n)(*((volatile unsigned long *)(0xE0000000+4*n)))
#define DISPLAY_DBG
/* USER CODE END PD */

TIM_HandleTypeDef htim2;

void SystemClock_Config(void);
static void MX_GPIO_Init(void);
static void MX_TIM2_Init(void);

int KalmanFilter(float *InputArray, float *OutputArray, kalman_state *kstate, int length){
	for (int i = 0; i<length; i++){
			kalman(&kstate, InputArray[i]);
			OutputArray[i] = kstate->x;

		}
	return 0;
	/*
	for(int i = 0; i < sizeof(InputArray); i++){
		//if(InputArray[i] < 0){
		//	return 1;
		//}
		float measurement = InputArray[i];
		kalman(&kstate,measurement);
		OutputArray[i] = kstate->x;
	}

	 * */
	 //return OutputArray;
}

int kalman_c(float *InputArray, float *OutputArray, kalman_state *kstate, int length){
	int i = 0;
	while (i < length){
		kstate->p = kstate->p + kstate->q;
		kstate->k = kstate->p / (kstate->p + kstate->r);
		kstate->x = kstate->x + kstate->k * (InputArray[i] - kstate->x);
		kstate->p = (1-kstate->k)*kstate->p;
		OutputArray[i] = kstate->x;
		i++;

	}
	return 0;

}

void sub_c(float *input1, float *input2, float *diff, int len){
	int i = 0;
	while(i <len){
		diff[i] = input1[i] - input2[i];
		i++;
	}
}

void avg_c(float *input,  int len, float *out){
	int i = 0;
	while(i<len){
		*out += input[i];
		i++;
	}
	*out /= len;
}

void stdev_c(float *input, int len, float *result){
	float ss = 0;
	float sum = 0;
	int i = 0;
	while (i < len){
		ss += input[i]*input[i];
		sum += input[i];
		i++;
	}
	*result = sqrt((ss-(sum*sum)/len) / (len-1));
}

void conv_c(float *input1, float *input2, float *result, int len){
	int i,j;
	int newLen = 2*len -1;
	for(i=0; i<newLen; i++){
		result[i]=0.0;
		for(j=0;j<len;j++){
			int new = i-j;
			if(new<0){
				break;
			} else if (new<len){
				result[i] += input1[j] * input2[new];
			}
		}
	}
}

void corr_c(float *input1, float *input2, float *result, int len){
	int i,j;
	int newLen = 2*len -1;
	for(i=0; i< newLen; i++){
		result[i] = 0.0;
		for(j=0;j<len;j++){
			int new = len + j - i- 1;
			if(new == 0 || ((new>0)&&(new<len))){
				result[i] = result[i] + input1[j]*input2[new];
			}

		}
	}
}

	/*
	float mean1 = 0;
	float mean2 = 0;
	int i=0;
	while(i<len){
		mean1 += input1[i];
		i++;
	}
	mean1 = mean1/len;
	i=0;
	while(i<len){
			mean2 += input2[i];
			i++;
		}
	mean2 = mean2/len;
	float numerator = 0;
	float denominator = 0;
	float denominator1 = 0;
	float denominator2 = 0;
	i = 0;
	while(i<len){
		numerator = numerator + (input1[i]-mean1)*(input2[i]-mean2);
		i++;
	}
	i = 0;
	while(i<len){
		denominator1 = denominator1 + pow((input1[i]-mean1),2);
		i++;
	}
	i=0;
	while(i<len){
			denominator2 = denominator2 + pow((input2[i]-mean2),2);
			i++;
		}
	denominator = sqrt(denominator1*denominator2);
	*result = numerator / denominator;
	*result */

void kalman_cmsis(float *inputArr, float *cmsis_output, int len, kalman_state *ks){
	float sum_pr = 0;
	float sub_mx = 0;
	float mul_x = 0;
	float sub_k = 0;
	float a = 1;
	for(int i = 0; i< len; i++){
		//p=p+q
		arm_add_f32(&ks->p, &ks->q, &ks->p, 1);
		arm_add_f32(&ks->p, &ks->r, &sum_pr, 1);
		(ks->k) = (ks->p)/sum_pr;
		arm_sub_f32(&inputArr[i], &ks->x, &sub_mx, 1);
		arm_mult_f32(&ks->k, &sub_mx, &mul_x, 1);
		arm_add_f32(&ks->x, &mul_x, &ks->x, 1);
		arm_sub_f32(&a, &ks->k, &sub_k, 1);
		arm_mult_f32(&sub_k, &ks->q, &ks->p, 1);
		*(cmsis_output + i) = ks->x;
	}

}
//float array_test[] = {0.0, 1.0, 2.0, 3.0, 4.0, 5.0};

float array_test[] = {10.4915760032, 10.1349974709, 9.53992591829, 9.60311878706, 10.4858891793,
		10.1104642352, 9.51066931906, 9.75755656493, 9.82154078273, 10.2906541933, 10.4861328671,
		9.57321181356, 9.70882714139, 10.4359069357, 9.70644021369, 10.2709894039, 10.0823149505,
		10.2954563443, 9.57130449017, 9.66832136479, 10.4521677502, 10.4287240667, 10.1833650752,
		10.0066049721, 10.3279461634, 10.4767210803, 10.3790964606, 10.1937408814, 10.0318963522,
		10.4939180917, 10.2381858895, 9.59703103024, 9.62757986516, 10.1816981174, 9.65703773168,
		10.3905666599, 10.0941977598, 9.93515274393, 9.71017053437, 10.0303874259, 10.0173504397,
		9.69022731474, 9.73902896102, 9.52524419732, 10.3270730526, 9.54695650657, 10.3573960542,
		9.88773266876, 10.1685038683, 10.1683694089, 9.88406620159, 10.3290065898, 10.2547227265,
		10.4733422906, 10.0133952458, 10.4205693583, 9.71335255372, 9.89061396699, 10.1652744131,
		10.2580948608, 10.3465431058, 9.98446410493, 9.79376005657, 10.202518901, 9.83867150985,
		9.89532986869, 10.2885062658, 9.97748768804, 10.0403923759, 10.1538911808, 9.78303667556,
		9.72420149909, 9.59117495073, 10.1716116012, 10.2015818969, 9.90650056596, 10.3251329834,
		10.4550120431, 10.4925749165, 10.1548177178, 9.60547133785, 10.4644672766, 10.2326496615,
		10.2279703226, 10.3535284606, 10.2437410625, 10.3851531317, 9.90784804928, 9.98208344925,
		9.52778805729, 9.69323876912, 9.92987312087, 9.73938925207, 9.60543743477, 9.79600805462,
		10.4950988486, 10.2814361401, 9.7985283333, 9.6287888922, 10.4491538991, 9.5799256668};

kalman_state cmsis;

int size = sizeof(array_test)/sizeof(float);

int main(void)
{
	/*
	// ---- TESTING ARM_LIB ----
	float array1[10];
	float array2[10];
	float32_t result[19];
	float32_t resultNum;
	arm_conv_f32(array1, 10, array2, 10, result);
	arm_std_f32(array1, 10, &resultNum);
	// ----
	 */

	//CMSIS Declarations
	float cmsis_output[size];
	float cmsis_diff[size];
	float cmsis_stdev;
	float cmsis_diffavg;
	float cmsis_corr[2*size-1];
	float cmsis_conv[2*size-1];

	float c_output[size];
	float c_diff[size];
	float c_stdev;
	float c_diffavg;
	float c_corr[2*size-1];
	float c_conv[2*size-1];

	float asm_output[size];
	float asm_diff[size];
	float asm_stdev;
	float asm_diffavg;
	float asm_corr[2*size-1];
	float asm_conv[2*size-1];
	// float *measurement;
	/*
	float q = 0.1;
	float r = 0.1;
	float x = 1.67;
	float p = 0.067;
	float k = 1.5;
	float measurement = 1.7;
	*/

  /* MCU Configuration--------------------------------------------------------*/

  /* Reset of all peripherals, Initializes the Flash interface and the Systick. */
  HAL_Init();

  /* Configure the system clock */
  SystemClock_Config();

  /* Initialize all configured peripherals */
  MX_GPIO_Init();
  MX_TIM2_Init();
  struct kalman_state c_state;
  struct kalman_state kstate;
  /* Infinite loop */

  while (1)
  {

	  //Initial Values
		float q = 0.1;
		float r = 0.1;
		float x = 5.0;
		float p = 0.1;
		float k = 0.0;
		//float measurement;

		c_state.q = q;
		c_state.r = r;
		c_state.x = x;
		c_state.p = p;
		c_state.k = k;

		cmsis.q = q;
		cmsis.r = r;
		cmsis.x = x;
		cmsis.p = p;
		cmsis.k = k;

		kstate.q = q;
		kstate.r = r;
		kstate.x = x;
		kstate.p = p;
		kstate.k = k;

		ITM_Port32(31) = 1;
		//  ------------ CMSIS IMPLEMENTATIONS  ------------
		kalman_cmsis(array_test, cmsis_output, size, &cmsis);
		ITM_Port32(31) = 2;

		//1. Subtraction
		arm_sub_f32(array_test, cmsis_output, cmsis_diff, size);

		//2. Standard Deviation and Average of Differences
		arm_std_f32(cmsis_diff, size, &cmsis_stdev);
		arm_mean_f32(cmsis_diff, size, &cmsis_diffavg);
		//3. Correlation
		arm_correlate_f32(array_test, size, cmsis_output, size, cmsis_corr);
		//4. Convolution
		arm_conv_f32(array_test, size, cmsis_output, size, cmsis_conv);
		//  ------------ END OF CMSIS IMPLEMENTATIONS  ------------
		ITM_Port32(31) = 3;

		//  ------------ C IMPLEMENTATIONS  ------------
		kalman_c(array_test, c_output, &c_state, size);
		ITM_Port32(31) = 4;

		sub_c(array_test, c_output, c_diff, size);
		stdev_c(c_diff, size, &c_stdev);
		avg_c(c_diff, size, &c_diffavg);
		conv_c(array_test, c_output, c_conv, size);
		corr_c(array_test, c_output, c_corr, size);
		//  ------------ C IMPLEMENTATIONS  ------------
		ITM_Port32(31) = 5;
		for (int i = 0; i<size; i++){
			//measurement = array_test[i];
			kalman(&kstate, array_test[i]);
			asm_output[i] = kstate.x;
		}
		ITM_Port32(31) = 6;

		// ------------ ASSEMBLY IMPLEMENTATION ------------
		//KalmanFilter(array_test, asm_output, &kstate, size);
		sub_c(array_test, asm_output, asm_diff, size);
		stdev_c(asm_diff, size, &asm_stdev);
		avg_c(c_diff, size, &asm_diffavg);
		conv_c(array_test, asm_output, asm_conv, size);
		corr_c(array_test, asm_output, asm_corr, size);
		ITM_Port32(31) = 7;

  }
}

void SystemClock_Config(void)
{
  RCC_OscInitTypeDef RCC_OscInitStruct = {0};
  RCC_ClkInitTypeDef RCC_ClkInitStruct = {0};

  /** Configure the main internal regulator output voltage
  */
  if (HAL_PWREx_ControlVoltageScaling(PWR_REGULATOR_VOLTAGE_SCALE1_BOOST) != HAL_OK)
  {
    Error_Handler();
  }
  /** Initializes the RCC Oscillators according to the specified parameters
  * in the RCC_OscInitTypeDef structure.
  */
  RCC_OscInitStruct.OscillatorType = RCC_OSCILLATORTYPE_MSI;
  RCC_OscInitStruct.MSIState = RCC_MSI_ON;
  RCC_OscInitStruct.MSICalibrationValue = 0;
  RCC_OscInitStruct.MSIClockRange = RCC_MSIRANGE_6;
  RCC_OscInitStruct.PLL.PLLState = RCC_PLL_ON;
  RCC_OscInitStruct.PLL.PLLSource = RCC_PLLSOURCE_MSI;
  RCC_OscInitStruct.PLL.PLLM = 1;
  RCC_OscInitStruct.PLL.PLLN = 60;
  RCC_OscInitStruct.PLL.PLLP = RCC_PLLP_DIV2;
  RCC_OscInitStruct.PLL.PLLQ = RCC_PLLQ_DIV2;
  RCC_OscInitStruct.PLL.PLLR = RCC_PLLR_DIV2;
  if (HAL_RCC_OscConfig(&RCC_OscInitStruct) != HAL_OK)
  {
    Error_Handler();
  }
  /** Initializes the CPU, AHB and APB buses clocks
  */
  RCC_ClkInitStruct.ClockType = RCC_CLOCKTYPE_HCLK|RCC_CLOCKTYPE_SYSCLK
                              |RCC_CLOCKTYPE_PCLK1|RCC_CLOCKTYPE_PCLK2;
  RCC_ClkInitStruct.SYSCLKSource = RCC_SYSCLKSOURCE_PLLCLK;
  RCC_ClkInitStruct.AHBCLKDivider = RCC_SYSCLK_DIV1;
  RCC_ClkInitStruct.APB1CLKDivider = RCC_HCLK_DIV1;
  RCC_ClkInitStruct.APB2CLKDivider = RCC_HCLK_DIV1;

  if (HAL_RCC_ClockConfig(&RCC_ClkInitStruct, FLASH_LATENCY_5) != HAL_OK)
  {
    Error_Handler();
  }
}

static void MX_TIM2_Init(void)
{

  TIM_ClockConfigTypeDef sClockSourceConfig = {0};
  TIM_MasterConfigTypeDef sMasterConfig = {0};

  htim2.Instance = TIM2;
  htim2.Init.Prescaler = 40000;
  htim2.Init.CounterMode = TIM_COUNTERMODE_UP;
  htim2.Init.Period = 3000;
  htim2.Init.ClockDivision = TIM_CLOCKDIVISION_DIV1;
  htim2.Init.AutoReloadPreload = TIM_AUTORELOAD_PRELOAD_DISABLE;
  if (HAL_TIM_Base_Init(&htim2) != HAL_OK)
  {
    Error_Handler();
  }
  sClockSourceConfig.ClockSource = TIM_CLOCKSOURCE_INTERNAL;
  if (HAL_TIM_ConfigClockSource(&htim2, &sClockSourceConfig) != HAL_OK)
  {
    Error_Handler();
  }
  sMasterConfig.MasterOutputTrigger = TIM_TRGO_RESET;
  sMasterConfig.MasterSlaveMode = TIM_MASTERSLAVEMODE_DISABLE;
  if (HAL_TIMEx_MasterConfigSynchronization(&htim2, &sMasterConfig) != HAL_OK)
  {
    Error_Handler();
  }

}

static void MX_GPIO_Init(void)
{

  /* GPIO Ports Clock Enable */
  __HAL_RCC_GPIOA_CLK_ENABLE();
  __HAL_RCC_GPIOB_CLK_ENABLE();

}

void Error_Handler(void)
{
  __disable_irq();
  while (1)
  {
  }
}

/************************ (C) COPYRIGHT STMicroelectronics *****END OF FILE****/
